## CMakeLists.txt
```
cmake_minimum_required(VERSION 3.20.0)
find_package(Zephyr REQUIRED HINTS $ENV{ZEPHYR_BASE})
project(nrf54l15_sniffer)

# shared/ is a submodule: github.com/Thenewmanator15/sniffer-wire-format,
# compiled by the ESP32-C6 firmware too. It is pinned to a commit, so this
# firmware does not move when the wire format does until it is told to --
# and a stale pin is visible in `git status` rather than silent.
#
#     git submodule update --init
#
# frame.c is COMPILED here, not copied: two implementations of one wire
# format drift, and the drift would be invisible -- a capture from one
# board would decode and a capture from the other would not, with nothing
# to say which was wrong.
#
# Byte-identity between the boards is therefore a property of the build rather
# than something the tests have to catch. The golden vectors go back to
# guarding what they were written for, which is drift between C and Python.
target_sources(app PRIVATE
    src/main.c
    src/link.c
    src/radio154.c
    src/radio_ble.c
    src/control.c
    src/batch.c
    src/log_backend_sn.c
    shared/frame.c
)
target_include_directories(app PRIVATE shared)

# Mirrors firmware/main/CMakeLists.txt, so both boards are driven the same way.
#   west build -b xiao_nrf54l15/nrf54l15/cpuapp -- -DSN_MODE=2
# SN_MODE 0 = conformance burst (default, used by the host test suite)
# SN_MODE 2 = capture
if(DEFINED SN_MODE)
    target_compile_definitions(app PRIVATE SN_MODE=${SN_MODE})
endif()
```

## prj.conf
```kconfig
# No USB anywhere in this file, deliberately. The nRF54L15 has no USB device
# controller -- within the nRF54L family that is the LM20A and LM20B only --
# so the host is reached through the board's SAMD11 CMSIS-DAP bridge over a
# UART. Nordic's own 802154_sniffer sample configures CDC-ACM and cannot run
# here for exactly that reason.

CONFIG_SERIAL=y
# link.c hands whole spans to EasyDMA (uart_tx) and receives asynchronously
# (uart_rx_enable), which needs this API rather than the interrupt-driven one.
# Two reasons, both measured: DMA reaches 94% of line rate where per-byte
# uart_poll_out reached 78%, and sn_link_send() no longer blocks its caller --
# which is the radio driver's RX thread. At 115200 a 130-byte frame used to
# hold that thread for about 11 ms. See docs/2026-09-14-nrf54l15-spike.md.
#
# Without this the build still succeeds and the board says nothing at all:
# uart_callback_set() returns -ENOTSUP, sn_link_init() fails, main() returns.
CONFIG_UART_ASYNC_API=y

# The capture stream owns the UART. There is only one, so anything else
# writing to it puts unframed bytes into the data path -- which is precisely
# what test_no_unframed_bytes_once_synchronised fails you for. This is not
# tidiness; it is the reason that test exists.
CONFIG_CONSOLE=n
CONFIG_UART_CONSOLE=n
CONFIG_SHELL=n
CONFIG_BOOT_BANNER=n
CONFIG_NCS_BOOT_BANNER=n
CONFIG_PRINTK=n

# Logging travels inside the frame protocol, never to the UART directly.
# LOG_BACKEND_UART=n is the point of the exercise: leaving it on would put raw
# text in the middle of the capture stream.
CONFIG_LOG=y
CONFIG_LOG_BACKEND_UART=n
CONFIG_LOG_MODE_DEFERRED=y
# Compiles log_output.c, which the custom backend formats through. Normally a
# built-in backend selects it; there is no built-in backend here, so it has to
# be asked for.
CONFIG_LOG_OUTPUT=y

# Not optional, and not a performance tweak.
#
# The driver's RX thread defaults to 800 bytes and was measured at 792 used.
# Anything that adds to that stack stops reception -- silently: start()
# returns 0, the channel reads back, promiscuous reads back true, and no frame
# ever arrives. Enabling logging is exactly the kind of thing that adds to it,
# which is why this sits directly beneath the CONFIG_LOG above. Deferred mode
# keeps formatting off that thread; this is the margin that does not depend on
# that remaining true. See docs/2026-09-14-nrf54l15-spike.md.
CONFIG_IEEE802154_NRF5_RX_STACK_SIZE=2048

CONFIG_MAIN_STACK_SIZE=4096

# Bluetooth LE: the controller only, driven straight over HCI.
#
# BT_HCI_RAW means no host stack is built. The application sends HCI commands
# and receives the controller's events verbatim, which is exactly what the
# ESP32-C6 firmware does over VHCI -- so both boards hand the host the same
# bytes for the same air traffic, and Wireshark's own HCI dissector reads them.
# A host stack would insist on parsing advertisements into its own structures
# and hand back something reassembled rather than what was heard.
#
# BT_LL_SOFTDEVICE, not Zephyr's BT_CTLR: on nRF the link layer is Nordic's
# SoftDevice Controller, and BT_CTLR is not a defined symbol here at all --
# setting it fails the build with "attempt to assign to the undefined symbol".
CONFIG_BT=y
CONFIG_BT_HCI_RAW=y
CONFIG_BT_LL_SOFTDEVICE=y
CONFIG_BT_OBSERVER=y
CONFIG_BT_EXT_ADV=y

# Observer ONLY, and this is load-bearing rather than tidiness.
#
# A raw controller defaults to every role. With BT_CENTRAL enabled, NCS's
# hci_driver calls sdc_support_ext_central() INSTEAD of
# sdc_support_ext_scan() -- the two are guarded by
# `if (!IS_ENABLED(CONFIG_BT_CENTRAL))` -- and standalone extended scanning
# is then never enabled in the controller. The symptom is precise and
# unhelpful: every setup command succeeds, and LE Set Extended Scan Enable
# alone comes back 0x12, Invalid HCI Command Parameters, with parameters that
# are correct.
#
# It also happens to be the truth about this firmware. It cannot connect and
# it cannot advertise; it listens.
CONFIG_BT_CENTRAL=n
CONFIG_BT_PERIPHERAL=n
CONFIG_BT_BROADCASTER=n

# An extended advertising report can fill an HCI event. The default is smaller
# than that, and the shortfall would arrive as truncation rather than an error.
CONFIG_BT_BUF_EVT_RX_SIZE=255

# Periodic advertising sync, and the isochronous streams a sync leads to.
#
# These are HOST symbols and there is no host here, which is exactly why they
# are easy to miss: NCS's hci_driver reads them to decide which features to
# enable in the controller --
#
#     if (IS_ENABLED(CONFIG_BT_PER_ADV_SYNC))  sdc_support_le_periodic_sync();
#     if (IS_ENABLED(CONFIG_BT_CTLR_SYNC_ISO)) sdc_support_bis_sink();
#
# Without the first, LE Periodic Advertising Create Sync is refused by a
# controller that was never built to do it, and the refusal names neither the
# command nor the reason. That is the same shape as the failure that cost an
# afternoon when BT_CENTRAL was left on and extended scanning was silently
# not enabled.
CONFIG_BT_PER_ADV_SYNC=y
CONFIG_BT_ISO_SYNC_RECEIVER=y

# One switch does both. BT_ISO_SYNC_RECEIVER selects BT_PER_ADV_SYNC and
# BT_ISO, and BT_CTLR_SYNC_ISO defaults to y from it, so asking for the
# receiver role is what turns on periodic sync AND the isochronous sink in
# the controller. BT_ISO itself is a hidden symbol and cannot be set here;
# BT_CTLR_SYNC_ISO is refused directly for an unmet dependency.

# Somewhere for isochronous data to land. A BIS carries audio at a steady
# rate, so too few buffers shows up as gaps in a capture rather than as an
# error anyone would notice.
CONFIG_BT_ISO_RX_BUF_COUNT=8
CONFIG_BT_ISO_RX_MTU=310

# Streams the controller can receive. NCS's hci_driver sizes the SoftDevice
# Controller's BIS sinks from CONFIG_BT_CTLR_SYNC_ISO_STREAM_COUNT, which
# defaults to this, and it defaulted to 1 -- so every stereo broadcast, two
# streams, was refused. radio_ble.c asks for no more than this many.
CONFIG_BT_ISO_MAX_CHAN=2

# Identity resolving keys: the controller's resolving list lets a scan report
# and filter a device that changes its address under its identity address.
# Both are defaults today; stated so a changed default cannot quietly take the
# feature away. The host reads the same size from boards.py "ble_keys".
CONFIG_BT_CTLR_PRIVACY=y
CONFIG_BT_CTLR_RL_SIZE=8

# CONFIG_REGULATOR and CONFIG_REGULATOR_FIXED come from the board's own
# defconfig and must not be turned off: they are what drives rfsw_pwr and
# rfsw_ctl at boot. Without them the RF switch is unpowered and the radio
# reaches its antenna only through leakage -- the same failure
# firmware/main/board.h documents on the C6.

# The radio. These values are the ones Nordic's own 802154_sniffer sample
# uses, read from the installed SDK rather than remembered -- except
# RX_BUFFERS, which their sample sets to 120 for an nRF52840. 16 is plenty
# here and was what reception was finally proved with.
#
# Reception on this part is NOT supported by Nordic and was hard-won. Two
# binaries with byte-identical Kconfig were found to differ deterministically,
# so if frames stop arriving after an unrelated change, read
# docs/2026-09-14-nrf54l15-spike.md before suspecting anything else.
CONFIG_NETWORKING=y
CONFIG_IEEE802154=y
CONFIG_IEEE802154_RAW_MODE=y
# Raw mode defaults this on, and the driver then hands over every frame with
# its last two bytes still attached (ieee802154_nrf5.c), which the capture
# carried as though they were the frame's own. Wireshark read them as part of
# the MIC, so no secured frame from this board ever decrypted: 0 MLE commands
# from a Thread network whose C6 capture decrypts as it stands, and 296 IPv6
# frames once the two bytes were cut off with editcap.
CONFIG_IEEE802154_L2_PKT_INCL_FCS=n
CONFIG_NET_PKT_TIMESTAMP=y
# Nordic's sample also sets NRF_RTC_TIMER_USER_CHAN_COUNT=3. It belongs to the
# RTC timer driver, which this part does not use -- the nRF54L15 times with the
# GRTC -- so here it was an unmet assignment and a warning on every build.
# Removing it left the generated .config byte-identical.
CONFIG_NRF_802154_RX_BUFFERS=16
```

## src/main.c
```c
/* The XIAO nRF54L15 half of the sniffer.
 *
 * Speaks the same wire format as the ESP32-C6 firmware, by compiling the same
 * frame.c rather than reimplementing it. See shared/frame.h.
 */

#include <zephyr/kernel.h>
#include <zephyr/logging/log.h>

#include "control.h"
#include "frame.h"
#include "link.h"
#include "radio154.h"
#include "radio_ble.h"

/* Wire format this firmware speaks. Must match the nrf54l15 entry in
 * EXPECTED_FIRMWARE_VERSIONS in host/src/esp32c6_sniffer/capture.py; the host
 * refuses to open a capture until the two agree, because an older board packs
 * its metadata differently and every field would then decode to a confident
 * wrong number rather than an error.
 *
 * 7: 802.15.4 frames arrive without the two FCS bytes that 6 and earlier
 * left on the end of every one, which kept any secured frame from
 * decrypting; and "Legacy only" and the external antenna work. A host
 * reading 6 would present frames that never decrypt as though they were
 * fine, so it is told to reflash instead. */
#define SN_FIRMWARE_VERSION 7u

LOG_MODULE_REGISTER(sniffer, LOG_LEVEL_INF);

#ifndef SN_MODE
#define SN_MODE 0
#endif

#define SN_MODE_CONFORMANCE 0
#define SN_MODE_CAPTURE     2

uint32_t sn_firmware_version(void)
{
	return SN_FIRMWARE_VERSION;
}

#if SN_MODE == SN_MODE_CONFORMANCE
/* The same burst firmware/main/main.c emits, in the same order, so the host's
 * existing conformance test holds BOTH boards to one set of vectors without
 * knowing there is more than one board. Payloads are transcribed from
 * host/tests/vectors/golden.json; the sequence numbers are assigned by the
 * link at runtime, which is why the host compares types and payloads and then
 * re-encodes to check the bytes. */
static void conformance_burst(void)
{
	static uint8_t all_bytes[256];

	for (int i = 0; i < 256; i++) {
		all_bytes[i] = (uint8_t)i;
	}
	static const uint8_t newline_bytes[] = {0x0a, 0x0d, 0x0a, 0x00, 0xff};
	static const char hello[] = "hello";
	static const char wrap[] = "wrap";
	static const char logmsg[] = "I (123) tag: msg";
	/* A three-entry batch on channel 25 -- base 1000000 us, deltas 0/450/2550,
	 * the last entry a real acknowledgement -- and a ring 48000 bytes deep
	 * with a 128 KB high-water mark of 192 KB capacity. Transcribed from
	 * host/tests/vectors/golden.json; the layouts are authoritative in
	 * host/src/esp32c6_sniffer/batch.py. */
	static const uint8_t batch_three[] = {
		0x40, 0x42, 0x0f, 0x00, 0x00, 0x00, 0x00, 0x00, 0x19, 0x03,
		0x00, 0x00, 0xc8, 0xc4, 0x05, 0x68, 0x65, 0x6c, 0x6c, 0x6f,
		0xc2, 0x01, 0xc7, 0xc3, 0x05, 0x0a, 0x0d, 0x0a, 0x00, 0xff,
		0xf6, 0x09, 0x00, 0x9e, 0x05, 0x02, 0x00, 0x1e, 0x00, 0xf2,
	};
	static const uint8_t link_status[] = {
		0x80, 0xbb, 0x00, 0x00, 0x00, 0x00, 0x02, 0x00, 0x00, 0x00, 0x03, 0x00,
	};

	while (true) {
		sn_link_send(SN_FRAME_HEARTBEAT, NULL, 0);
		sn_link_send(SN_FRAME_PACKET, (const uint8_t *)hello, sizeof(hello) - 1);
		sn_link_send(SN_FRAME_PACKET, newline_bytes, sizeof(newline_bytes));
		sn_link_send(SN_FRAME_PACKET, all_bytes, sizeof(all_bytes));
		sn_link_send(SN_FRAME_PACKET, (const uint8_t *)wrap, sizeof(wrap) - 1);
		sn_link_send(SN_FRAME_LOG, (const uint8_t *)logmsg, sizeof(logmsg) - 1);
		/* PACKET_BATCH and LINK, identical bytes to firmware/main/main.c and
		 * to golden.json, in the same position in the burst. */
		sn_link_send(SN_FRAME_PACKET_BATCH, batch_three, sizeof(batch_three));
		sn_link_send(SN_FRAME_LINK, link_status, sizeof(link_status));
		k_sleep(K_MSEC(500));
	}
}
#endif

#if SN_MODE == SN_MODE_CAPTURE
/* Published once a second, laid out exactly as the ESP-IDF firmware lays it
 * out: five link counters, three for the 802.15.4 radio, thirteen for Wi-Fi
 * and eleven for BLE. The host reads all four blocks by position and decides
 * from the payload's length how many counters a given firmware sent.
 *
 * The Wi-Fi block is thirteen zeros and stays: this board has no Wi-Fi radio,
 * but the BLE block sits behind that space and every counter in it would be
 * read as a Wi-Fi one if it were closed up.
 *
 * Thirteen because the C6's sn_80211_stats_t is thirteen wide -- it ends with
 * fcs_length_unknown. This said twelve, copied from what the host once read
 * rather than from what the C6 sends, and when the host was corrected to
 * thirteen every BLE counter here moved one place: a board reporting more
 * advertising reports than HCI packets, which a subset cannot be.
 * test_stats_layout.py now checks this width against the C6's header.
 *
 * Sending BLE is new. The counters existed and reached nobody -- two
 * accessors that nothing called -- so a BLE capture here reported
 * sn_radio154_captured(), which is a stopped radio's zero, and the file's
 * statistics block said no loss whatever the link had refused.
 *
 * frames_dropped_ringfull is a real measurement: the outbound ring can fill
 * if the host stops draining, and a frame refused at that point is loss the
 * operator should be told about. short_writes and tx_stalls stay zero
 * deliberately -- this link does not detect either, so reporting anything but
 * zero would invent a measurement.
 *
 * Not packed, and the C6's copy is not either: every member is a uint32_t, so
 * the layout is already gap-free at four-byte alignment, and packing it would
 * only make taking the address of the BLE block unsafe. */
struct sn_stats_full {
	uint32_t frames_sent;
	uint32_t frames_dropped_ringfull;
	uint32_t short_writes;
	uint32_t tx_stalls;
	uint32_t bytes_sent;
	uint32_t frames_captured;
	uint32_t isr_queue_full;
	uint32_t link_rejected;
	uint32_t wifi[13];
	struct sn_ble_stats ble;
	/* Firmware 4. 802.15.4 frames the radio discarded for a bad FCS, which
	 * the C6 cannot see: appended after every block, because the host reads
	 * by position and takes a longer frame as a newer one. */
	uint32_t fcs_failed;
};

/* The outbound ring's occupancy, unpacked by the host as "<III". Occupancy
 * only -- frames refused because the ring was full travel in STATS above, and
 * counting them here as well would double them in the pcapng statistics.
 *
 * queued_bytes is how far behind real time the host is; divide by the drain
 * rate for seconds. high_water is the worst it reached this session, which is
 * the number that survives a burst nobody was watching for. */
struct __attribute__((packed)) sn_link_status {
	uint32_t queued_bytes;
	uint32_t high_water;
	uint32_t capacity;
};

static void stats_tick(struct k_work *work);
static K_WORK_DELAYABLE_DEFINE(stats_work, stats_tick);

static void stats_tick(struct k_work *work)
{
	ARG_UNUSED(work);

	struct sn_stats_full stats = {
		.frames_sent = sn_link_frames_sent(),
		.frames_dropped_ringfull = sn_link_frames_dropped(),
		.short_writes = 0u,
		.tx_stalls = 0u,
		.bytes_sent = sn_link_bytes_sent(),
		.frames_captured = sn_radio154_captured(),
		.isr_queue_full = 0u,
		.link_rejected = sn_radio154_dropped(),
		.wifi = {0},
		.fcs_failed = sn_radio154_fcs_failed(),
	};

	/* Both radios' counters go in every frame, whichever is running, for
	 * the reason the C6 firmware gives: sending only the active one
	 * leaves the host unable to tell a zero counter from an absent one. */
	sn_radio_ble_get_stats(&stats.ble);

	sn_link_send(SN_FRAME_STATS, (const uint8_t *)&stats, sizeof(stats));

	/* Sent after STATS and measured before itself: the figure describes
	 * what was waiting, not what this frame added. */
	const struct sn_link_status link = {
		.queued_bytes = sn_link_queued(),
		.high_water = sn_link_high_water(),
		.capacity = sn_link_capacity(),
	};

	sn_link_send(SN_FRAME_LINK, (const uint8_t *)&link, sizeof(link));
	k_work_schedule(&stats_work, K_SECONDS(1));
}
#endif

int main(void)
{
	if (sn_link_init() != 0) {
		return -1;
	}

#if SN_MODE == SN_MODE_CONFORMANCE
	conformance_burst();
#elif SN_MODE == SN_MODE_CAPTURE
	if (sn_radio154_init() != 0) {
		return -1;
	}
	/* The controller is brought up but not scanning. Both radios are
	 * initialised at boot and neither is receiving: which one runs is the
	 * host's choice, made with SET_RADIO, and they share one antenna so
	 * only one can run at a time regardless.
	 *
	 * A failure here is not fatal to 802.15.4 capture, which is the
	 * radio this board was built for, so it is reported and stepped over
	 * rather than taking the firmware down with it. */
	if (sn_radio_ble_init() != 0) {
		LOG_ERR("Bluetooth controller would not start; 802.15.4 only");
	}
	sn_link_set_frame_handler(sn_control_handle);

	/* Travels as a LOG frame, not as bytes on the UART. If this ever
	 * appears as raw text in a capture, the backend is not installed and
	 * the data path is being corrupted. */
	LOG_INF("link up, mode=%d, firmware=%u", SN_MODE, SN_FIRMWARE_VERSION);

	/* The radio is NOT started here. For 802.15.4 the host sends no
	 * separate START -- SET_CHANNEL starts it, as capture.py's _configure
	 * says -- and starting at boot would capture on the default channel
	 * throughout the handshake and then attribute those frames to
	 * whichever channel was finally asked for. */
	k_work_schedule(&stats_work, K_SECONDS(1));

	while (true) {
		k_sleep(K_FOREVER);
	}
#endif
	return 0;
}
```

## src/batch.c
```c
#include "batch.h"

#include <string.h>

#include <zephyr/kernel.h>

#include "frame.h"
#include "link.h"
#include "radio154.h"

/* Limits from the wire format. The host rejects a batch that breaks any of
 * them rather than decoding half of one, so an encoder that produced one would
 * be producing frames no host will read. */
#define MAX_ENTRIES 32
#define MAX_PSDU    127
#define MAX_DT_US   0xFFFFu

#define HEADER_LEN  10   /* u64 base timestamp, u8 channel, u8 count */
#define ENTRY_LEN   5    /* u16 dt, u8 lqi, i8 rssi, u8 len */

/* Closes a batch by size as well as by count, as the BLE batcher does and at
 * its figure. Thirty-two near-full frames made a batch of up to 4234 bytes,
 * past the 4096 a frame can carry, and sn_link_send refused it whole: every
 * packet in it counted as lost, with room to spare in the ring. Trains of
 * broadcast 6LoWPAN fragments are exactly that shape. */
#define MAX_BATCH_BYTES 2048

/* Static, and deliberately so: this is filled from the radio driver's RX
 * thread, whose stack overflowing is the fault that cost days and that
 * docs/2026-09-14-nrf54l15-spike.md exists to document. Sized by the byte
 * limit, which one entry of at most 132 bytes always fits under. */
static uint8_t buf[MAX_BATCH_BYTES];
static size_t used = HEADER_LEN;   /* header written at flush, not at open */
static uint8_t count;
static uint64_t base_us;
static uint64_t last_us;
static uint8_t batch_channel;
static uint32_t dropped_packets;

/* Two contexts touch the buffer: the RX thread adding, and the system work
 * queue flushing on the linger timer. */
static K_MUTEX_DEFINE(lock);
static void linger_expired(struct k_work *work);
static K_WORK_DELAYABLE_DEFINE(linger, linger_expired);

static void put_le16(uint8_t *at, uint16_t v)
{
	at[0] = (uint8_t)(v & 0xFFu);
	at[1] = (uint8_t)(v >> 8);
}

/* Sends the open batch. The caller holds the lock. */
static void flush_locked(void)
{
	if (count == 0u) {
		return;
	}

	/* A batch of one is sent as a PACKET instead, because as a batch it
	 * would be BIGGER than the frame it replaces: 10 bytes of frame
	 * header, 10 of batch header and a 5-byte entry is 25, against 22 for
	 * a PACKET's header and metadata. Batching wins by amortising that
	 * batch header across many packets, so with one packet it loses.
	 *
	 * This is not a rare corner. A sniffer spends most of its life on a
	 * quiet channel, where the linger timer expires before a second
	 * packet ever arrives -- measured at 38 of 44 batches on this bench.
	 * Without this branch, batching would have made the common case three
	 * bytes per packet worse in exchange for the busy case being better. */
	if (count == 1u) {
		const uint8_t *entry = buf + HEADER_LEN;
		const uint8_t len = entry[4];
		/* Static for the same reason the batch buffer is: this can run
		 * on the radio driver's RX thread. The mutex the caller holds
		 * is what makes one shared scratch buffer safe. */
		static uint8_t one[sizeof(struct sn_154_meta) + MAX_PSDU];
		const struct sn_154_meta meta = {
			.channel = batch_channel,
			.lqi = entry[2],
			.rssi_dbm = (int8_t)entry[3],
			/* Always clear: the driver strips the FCS before we
			 * see a frame, which is why batch entries have no
			 * flags field to carry it in. */
			.flags = 0u,
			/* The first entry's delta is measured from the base,
			 * so it is zero and this is its exact capture time. */
			.timestamp_us = base_us,
		};

		memcpy(one, &meta, sizeof(meta));
		memcpy(one + sizeof(meta), entry + ENTRY_LEN, len);

		if (sn_link_send(SN_FRAME_PACKET, one,
				 sizeof(meta) + len) != 0) {
			dropped_packets++;
		}

		count = 0u;
		used = HEADER_LEN;
		return;
	}

	/* The header is written now rather than when the batch opened,
	 * because count is not known until it closes. */
	for (int i = 0; i < 8; i++) {
		buf[i] = (uint8_t)(base_us >> (8 * i));
	}
	buf[8] = batch_channel;
	buf[9] = count;

	/* A refused batch is every packet in it, not one drop. Counting it
	 * as one would report a thirty-second of the loss, and a sniffer that
	 * understates what it lost is worse than one that says nothing. */
	if (sn_link_send(SN_FRAME_PACKET_BATCH, buf, used) != 0) {
		dropped_packets += count;
	}

	count = 0u;
	used = HEADER_LEN;
}

static void linger_expired(struct k_work *work)
{
	ARG_UNUSED(work);

	k_mutex_lock(&lock, K_FOREVER);
	flush_locked();
	k_mutex_unlock(&lock);
}

void sn_batch_flush(void)
{
	/* Cancel first: a flush that has already been asked for would
	 * otherwise fire against an empty buffer and do nothing, which is
	 * harmless but makes the work queue look busier than it is. */
	(void)k_work_cancel_delayable(&linger);

	k_mutex_lock(&lock, K_FOREVER);
	flush_locked();
	k_mutex_unlock(&lock);
}

/* Zeroes the counters, when a host opens a session: this board does not
 * reboot when its port opens, so otherwise every capture would carry the
 * last one's counts. */
void sn_batch_reset_counters(void)
{
	dropped_packets = 0u;
}

uint32_t sn_batch_dropped(void)
{
	return dropped_packets;
}

void sn_batch_add(uint8_t channel, uint64_t timestamp_us, uint8_t lqi,
		  int8_t rssi_dbm, const uint8_t *psdu, size_t len)
{
	if (len > MAX_PSDU) {
		len = MAX_PSDU;
	}

	k_mutex_lock(&lock, K_FOREVER);

	/* Four things close a batch early: a new channel, a delta that will
	 * not fit or runs backwards, and a batch that would outgrow
	 * MAX_BATCH_BYTES. Each is a frame the host or the link would refuse
	 * rather than tolerate.
	 *
	 * A timestamp going backwards is the odd one. It should not happen --
	 * the clock is monotonic -- but if it ever did, a negative delta would
	 * wrap the unsigned subtraction into an enormous one and hand the host
	 * a confidently wrong time. Closing the batch keeps the damage to one
	 * frame's ordering instead. */
	if (count > 0u &&
	    (channel != batch_channel ||
	     timestamp_us < last_us ||
	     timestamp_us - last_us > MAX_DT_US ||
	     used + ENTRY_LEN + len > MAX_BATCH_BYTES)) {
		flush_locked();
	}

	if (count == 0u) {
		base_us = timestamp_us;
		batch_channel = channel;
		last_us = timestamp_us;
	}

	/* First entry's delta is measured from the base, so it is zero. */
	const uint16_t dt = (uint16_t)(timestamp_us - last_us);

	uint8_t *at = buf + used;
	put_le16(at, dt);
	at[2] = lqi;
	at[3] = (uint8_t)rssi_dbm;
	at[4] = (uint8_t)len;
	memcpy(at + ENTRY_LEN, psdu, len);

	used += ENTRY_LEN + len;
	last_us = timestamp_us;
	count++;

	if (count == MAX_ENTRIES) {
		flush_locked();
		(void)k_work_cancel_delayable(&linger);
	} else {
		/* Rescheduled on every packet, so the timer measures silence
		 * rather than the age of the batch. A busy channel therefore
		 * fills batches and a quiet one still delivers promptly. */
		(void)k_work_reschedule(&linger, K_MSEC(SN_BATCH_LINGER_MS));
	}

	k_mutex_unlock(&lock);
}
```

## src/batch.h
```c
#pragma once

#include <stdint.h>
#include <stddef.h>

/* Accumulates captured packets into SN_FRAME_PACKET_BATCH frames.
 *
 * A PACKET frame costs 10 bytes of header plus 12 of metadata, so a 5-byte
 * acknowledgement travels as 27 bytes. This board's link to the host is a UART
 * through the SAMD11 bridge, measured at 94.3 kB/s, and that overhead is most
 * of the budget on a channel carrying small frames back to back. One header
 * shared across up to 32 packets, the channel stated once and timestamps
 * delta-coded, brings it to about 5.6 bytes per packet.
 *
 * Every packet keeps its own capture timestamp, reconstructed exactly by the
 * host, so nothing about timing accuracy changes. What does change is when
 * frames reach the host: up to SN_BATCH_LINGER_MS later than they would have.
 * Wireshark shows capture time, not arrival time, so this is invisible in a
 * capture and visible only as latency on screen.
 *
 * A batch that closes with a single packet in it is sent as an ordinary
 * PACKET frame, because as a batch it would be three bytes larger than the
 * frame it replaces. That is the usual case on a quiet channel, so without it
 * batching would cost more than it saved most of the time.
 *
 * The layout is authoritative in the host package's esp32c6_sniffer/batch.py.
 */

/* Adds one captured packet, flushing first if it cannot join the open batch.
 *
 * Cannot fail at this point: the packet is copied into the open batch, and
 * whether it reaches the host is decided later, when that batch is sent. See
 * sn_batch_dropped().
 *
 * Called from the radio driver's RX thread. That thread's stack is the one
 * documented in the spike log as fatally tight, so everything here is static
 * and nothing large lands on it.
 */
void sn_batch_add(uint8_t channel, uint64_t timestamp_us, uint8_t lqi,
		  int8_t rssi_dbm, const uint8_t *psdu, size_t len);

/* Packets lost because the outbound ring was full when their batch was sent.
 *
 * Counted in PACKETS rather than frames, which is the number an operator
 * actually wants: one refused batch is up to 32 packets gone, and reporting
 * it as a single drop would understate the loss thirty-twofold. */
void sn_batch_reset_counters(void);
uint32_t sn_batch_dropped(void);

/* Sends whatever is buffered, if anything. Safe to call when empty.
 *
 * Called on the linger timer, and directly when capture stops or the channel
 * is retuned -- otherwise the last packets before a stop would sit in the
 * buffer until something else happened to arrive. */
void sn_batch_flush(void);

/* How long an incomplete batch waits for company before it is sent anyway.
 *
 * Bounds the latency a batch can add. Capture timestamps are unaffected --
 * every packet keeps its own, and Wireshark shows capture time rather than
 * arrival time -- so this is latency on screen and nothing else.
 *
 * 20 ms, and raising it was TRIED and reverted. The arithmetic says a longer
 * linger is free: simulated over 718 real packets, per-packet overhead falls
 * from 16.3 bytes at 20 ms to 11.2 at 50. Measured on the wire it is not
 * free at all, because bigger batches mean bigger frames and this link is
 * bridged by a SAMD11 that cannot take long uninterrupted bursts at 1 Mbaud:
 *
 *     linger  max frame  corrupt batches  resyncs  bytes discarded
 *      20 ms      426 B                0        0                0
 *      50 ms     1751 B                3        5             1491
 *
 * Twenty-five seconds each, same air. link.c documents the same bridge
 * losing 9 bytes mid-way through a 266-byte frame; 1751 is six times that.
 *
 * So the ceiling here is not the line rate and not the batch rate. It is how
 * much the bridge will swallow in one go, and a batch that grows past it
 * loses more packets than the saved bytes were worth. Anything that makes
 * frames longer -- a wider delta field, compression with a shared window --
 * runs into the same wall and should be measured against it before it is
 * believed. */
#define SN_BATCH_LINGER_MS 20
```

## src/control.c
```c
/* Control channel, host to board.
 *
 * The host's side is esp32c6_sniffer.control. Commands arrive framed exactly
 * as everything else does, so the same parser handles both directions.
 *
 * Payload layouts, from that module's docstring:
 *   command  5 bytes  "<BI"   command id, then a little-endian 32-bit value
 *   reply    6 bytes  "<BBI"  echoed command id, status, then a value
 *
 * The command id is echoed rather than correlated by sequence number, because
 * the board assigns sequence numbers and the host cannot know them in advance.
 *
 * Only the commands this board can honour are implemented. Every other id gets
 * SN_STATUS_UNKNOWN_COMMAND rather than silence: the host tolerates a reply it
 * does not recognise, but a missing one stalls it until a timeout.
 */

#include "control.h"

#include <zephyr/drivers/regulator.h>
#include <zephyr/logging/log.h>

#include <errno.h>
#include <stddef.h>
#include <stdint.h>

#include "batch.h"
#include "commands.h"
#include "frame.h"
#include "link.h"
#include "radio154.h"
#include "radio_ble.h"

LOG_MODULE_REGISTER(control, LOG_LEVEL_INF);

#define SN_CMD_PAYLOAD_LEN   5
#define SN_REPLY_PAYLOAD_LEN 6

/* From esp32c6_sniffer.control.Radio. BLE is 2, not 1 -- 1 is Wi-Fi, which
 * this part does not have. Guessing 1 here made the board accept a request
 * for Wi-Fi as though it were BLE and refuse the real thing, and the host
 * reported only "SET_RADIO failed, status 2". */
#define RADIO_154 0u
#define RADIO_WIFI 1u
#define RADIO_BLE 2u

/* Which radio the host selected. SET_CHANNEL, START and STOP are all
 * interpreted against it, so it is tracked rather than inferred: a START that
 * guessed wrong would start the other radio and capture nothing the operator
 * asked for. */
static uint8_t selected_radio = RADIO_154;

/* Held until START, because the host sends them before it. Zero means "not
 * set", which the radio turns into its default. */
static uint16_t ble_interval_ms;
static uint16_t ble_window_ms;
static uint8_t ble_phys = 1u;   /* the 1M PHY, which every advertiser uses */

/* The board's antenna switch: a regulator-fixed node on gpio2.5, active low
 * and on at boot. On (low) is the onboard ceramic antenna, off (high) the
 * IPEX connector: Seeed's getting-started guide for this board sets the pin
 * low for ceramic, its default, and high for external. Measured on a board
 * with an antenna fitted, switching reads every advertiser about 14.5 dB
 * apart, so the switch does switch. */
static const struct device *const rfsw_ctl = DEVICE_DT_GET(DT_NODELABEL(rfsw_ctl));

/* Antenna.INTERNAL is 0 and Antenna.EXTERNAL 1, as the host numbers them.
 * Through the regulator API rather than the pin, because the regulator
 * driver owns the pin; is_enabled keeps its reference count at one. */
static int set_antenna(uint32_t value)
{
	if (value > 1u) {
		return -EINVAL;
	}
	if (!device_is_ready(rfsw_ctl)) {
		return -ENODEV;
	}
	const bool onboard = value == 0u;

	if (onboard == regulator_is_enabled(rfsw_ctl)) {
		return 0;
	}
	return onboard ? regulator_enable(rfsw_ctl) : regulator_disable(rfsw_ctl);
}

/* Stops a radio, 802.15.4 with its open batch sent first, so the host sees
 * every packet before the reply that says capture has stopped. BLE resets
 * the controller whether it was scanning or not -- a START that failed
 * part-way has already loaded keys and a filter -- provided it came up at
 * all. */
static int stop_radio(uint8_t radio)
{
	if (radio == RADIO_BLE) {
		/* Not when the controller never came up: nothing would answer
		 * the reset, and GET_INFO would wait on it every session. */
		return sn_radio_ble_ready() ? sn_radio_ble_stop() : 0;
	}
	const int err = sn_radio154_stop();

	sn_batch_flush();
	return err;
}

static void reply(uint8_t command, uint8_t status, uint32_t value)
{
	uint8_t out[SN_REPLY_PAYLOAD_LEN];

	out[0] = command;
	out[1] = status;
	out[2] = (uint8_t)(value & 0xFFu);
	out[3] = (uint8_t)((value >> 8) & 0xFFu);
	out[4] = (uint8_t)((value >> 16) & 0xFFu);
	out[5] = (uint8_t)((value >> 24) & 0xFFu);

	sn_link_send(SN_FRAME_CONTROL_REPLY, out, sizeof(out));
}

void sn_control_handle(uint8_t type, const uint8_t *payload, size_t len)
{
	/* BLE_FILTER is a frame rather than a command: an accept list does not
	 * fit in a command's single 32-bit value. It is answered with no reply
	 * because the host sends it and moves on, exactly as it does to the
	 * ESP32-C6. */
	if (type == (uint8_t)SN_FRAME_BLE_FILTER) {
		sn_radio_ble_set_filter(payload, len);
		return;
	}
	/* Keys ride in a frame for the same reason the filter does, and are
	 * likewise not answered. radio_ble.c logs a refusal. */
	if (type == (uint8_t)SN_FRAME_BLE_KEYS) {
		(void)sn_radio_ble_set_keys(payload, len);
		return;
	}
	if (type != (uint8_t)SN_FRAME_CONTROL_CMD) {
		return;
	}
	if (len < SN_CMD_PAYLOAD_LEN) {
		return;
	}
	const uint8_t command = payload[0];
	const uint32_t value = (uint32_t)payload[1] |
			       ((uint32_t)payload[2] << 8) |
			       ((uint32_t)payload[3] << 16) |
			       ((uint32_t)payload[4] << 24);

	switch (command) {
	case SN_CMD_SET_RADIO:
		/* The host selects a radio before anything else, because
		 * SET_CHANNEL, START and STOP are interpreted against
		 * whichever is selected.
		 *
		 * Two exist here. Wi-Fi is RADIO_WIFI and does not exist on
		 * this part at all, so it is refused rather than quietly
		 * accepted. */
		if (value != RADIO_154 && value != RADIO_BLE) {
			reply(command, SN_STATUS_BAD_VALUE, value);
			break;
		}
		/* The radio left behind is stopped. It kept running, and its
		 * frames reached a host decoding them as the other radio's. */
		if (value != selected_radio) {
			(void)stop_radio(selected_radio);
		}
		selected_radio = (uint8_t)value;
		reply(command, SN_STATUS_OK, value);
		break;

	case SN_CMD_SET_BLE_PHYS:
		/* 1 is the 1M PHY, 4 adds Coded, 0 is legacy scanning. Zero
		 * was refused, so the host's "Legacy only" could not open a
		 * capture on this board at all. */
		if (value > 0xFFu) {
			reply(command, SN_STATUS_BAD_VALUE, value);
			break;
		}
		ble_phys = (uint8_t)value;
		reply(command, SN_STATUS_OK, value);
		break;

	case SN_CMD_SET_BLE_PERIODIC:
		/* Stored in the radio rather than here, because it is read on
		 * the path that sees each advertisement. */
		sn_radio_ble_set_periodic(value != 0u);
		reply(command, SN_STATUS_OK, value);
		break;

	case SN_CMD_SET_BLE_SCAN:
		/* Interval in the low 16 bits, window in the high 16, as
		 * capture.py packs them. Stored rather than applied: the host
		 * sends this before START, and the controller takes both in
		 * one command when scanning is configured. */
		ble_interval_ms = (uint16_t)(value & 0xFFFFu);
		ble_window_ms = (uint16_t)(value >> 16);
		reply(command, SN_STATUS_OK, value);
		break;

	case SN_CMD_SET_CHANNEL:
		/* BLE has no channel: the controller rotates the three
		 * advertising channels itself, and the host knows this and
		 * sends START instead. Arriving here means the host and the
		 * board disagree about the selected radio, which is worth a
		 * refusal rather than retuning a radio nobody asked about. */
		if (selected_radio == RADIO_BLE) {
			reply(command, SN_STATUS_BAD_VALUE, value);
			break;
		}
		/* The last channel's packets go now, not whenever the linger
		 * timer next fires. */
		sn_batch_flush();
		/* SET_CHANNEL starts the radio, which is what the host
		 * expects: for 802.15.4 it sends no separate START, and the
		 * comment in capture.py's _configure says so explicitly.
		 * Starting here rather than at boot also means nothing is
		 * captured on the default channel during the handshake and
		 * then attributed to the channel that was asked for. */
		if (sn_radio154_set_channel((uint8_t)value) != 0) {
			reply(command, SN_STATUS_BAD_VALUE, value);
			break;
		}
		/* Worth saying out loud. The operator picked a channel and the
		 * capture is about to be attributed to it, so a mismatch
		 * between what was asked for and what the radio took is the
		 * kind of thing that should be visible rather than inferred. */
		if (sn_radio154_start() != 0) {
			LOG_ERR("channel %u set but the radio would not start",
				(unsigned)value);
			reply(command, SN_STATUS_FAILED, value);
			break;
		}
		LOG_INF("channel %u, receiving", (unsigned)value);
		reply(command, SN_STATUS_OK, value);
		break;

	case SN_CMD_START:
		if (selected_radio == RADIO_BLE) {
			const int err = sn_radio_ble_start(ble_interval_ms,
							   ble_window_ms,
							   ble_phys);

			if (err != 0) {
				LOG_ERR("BLE scan would not start: %d", err);
			}
			reply(command,
			      err == 0 ? SN_STATUS_OK : SN_STATUS_FAILED, 0u);
			break;
		}
		reply(command,
		      sn_radio154_start() == 0 ? SN_STATUS_OK : SN_STATUS_FAILED,
		      0u);
		break;

	case SN_CMD_STOP:
		reply(command,
		      stop_radio(selected_radio) == 0 ? SN_STATUS_OK
						      : SN_STATUS_FAILED,
		      0u);
		break;

	case SN_CMD_GET_INFO:
		/* Every capture opens with this, so it starts a fresh session.
		 * This board does not reboot when its port opens, as the C6 does,
		 * so without it a second capture carried the first one's counts
		 * -- 104 frames written up as "509 received" -- and the last
		 * capture's PHY choice. */
		/* And from nothing running. A session that ended without a
		 * STOP -- a killed capture -- left its radio going, and its
		 * syncs with it, into this one. */
		(void)stop_radio(RADIO_154);
		(void)stop_radio(RADIO_BLE);
		/* And 802.15.4 selected, as the C6 is after its reboot. BLE stayed
		 * selected after a BLE capture, so a tool that did not select a
		 * radio -- survey.py -- had every channel and energy command
		 * refused, and reported a channel with a network on it as quiet. */
		selected_radio = RADIO_154;
		sn_link_reset_counters();
		sn_batch_reset_counters();
		sn_radio154_reset_counters();
		sn_radio_ble_reset_counters();
		/* Every setting back to its default, not only the PHY:
		 * periodic following and the scan timing carried over too, and
		 * a host that sent them only when set could not undo them. */
		ble_phys = 1u;
		ble_interval_ms = 0u;
		ble_window_ms = 0u;
		sn_radio_ble_set_periodic(false);
		(void)set_antenna(0u);
		/* The host refuses to open a capture until this matches
		 * EXPECTED_FIRMWARE_VERSIONS["nrf54l15"], because an older
		 * board packs its metadata differently and every field would
		 * then decode to a confident wrong number rather than an
		 * error. */
		reply(command, SN_STATUS_OK, sn_firmware_version());
		break;

	case SN_CMD_SET_ANTENNA: {
		/* It refused the external antenna, which the host offers
		 * because the board has the switch, so choosing it made the
		 * capture fail to open. */
		const int err = set_antenna(value);

		reply(command,
		      err == 0 ? SN_STATUS_OK
			       : err == -EINVAL ? SN_STATUS_BAD_VALUE
						: SN_STATUS_FAILED,
		      value);
		break;
	}

	case SN_CMD_ENERGY_DETECT: {
		/* Packed as the ESP32-C6 packs it: channel in the low byte,
		 * the window in 16 us symbols above it. This was refused as
		 * unknown until the survey was ported from Nordic's
		 * 802154_phy_test, and the nRF README listed "no spectrum
		 * survey" among this board's limitations.
		 *
		 * An 802.15.4 measurement, so refused while BLE is selected,
		 * for the reason SET_CHANNEL is: the host and the board
		 * disagreeing about the radio deserves a refusal rather than
		 * a measurement taken on the wrong one. */
		if (selected_radio == RADIO_BLE) {
			reply(command, SN_STATUS_BAD_VALUE, value);
			break;
		}

		int8_t dbm = 0;
		const int err = sn_radio154_energy_detect(
			(uint8_t)(value & 0xFFu), value >> 8, &dbm);

		if (err == -EINVAL) {
			reply(command, SN_STATUS_BAD_VALUE, value);
			break;
		}
		if (err != 0) {
			LOG_WRN("energy detection on %u failed: %d",
				(unsigned)(value & 0xFFu), err);
			reply(command, SN_STATUS_FAILED, value);
			break;
		}
		/* Signed, so widened through uint8_t for the host to
		 * reinterpret -- exactly as the C6 replies. */
		reply(command, SN_STATUS_OK, (uint32_t)(uint8_t)dbm);
		break;
	}

	default:
		reply(command, SN_STATUS_UNKNOWN_COMMAND, 0u);
		break;
	}
}
```

## src/control.h
```c
#pragma once

#include <stddef.h>
#include <stdint.h>

/* Handles the payload of one SN_FRAME_CONTROL_CMD and replies. Registered with
 * sn_link_set_command_handler, so it runs on the link's reader thread. */
void sn_control_handle(uint8_t type, const uint8_t *payload, size_t len);

/* Provided by main.c, so control.c need not see the build-mode macros. */
uint32_t sn_firmware_version(void);
```

## src/link.h
```c
#pragma once

#include <stddef.h>
#include <stdint.h>

#include "frame.h"

/* Brings up the UART the host reads, and starts the reader that feeds
 * sn_link_set_command_handler. Returns 0, or -ENODEV if the device is not
 * ready. */
int sn_link_init(void);

/* Frames a payload and writes it. Assigns the sequence number itself, so
 * nothing above this layer has to track one -- which is also why the host
 * matches command replies by echoed command id rather than by sequence.
 * Returns 0 on success. */
int sn_link_send(sn_frame_type_t type, const uint8_t *payload, size_t len);

/* Called for each frame the host sends, with its type, so one handler can
 * route them. The type is passed rather than assumed because the host sends
 * more than commands: BLE_FILTER carries an accept list, and a second setter
 * per frame type would multiply with every one added.
 *
 * Runs on the link's reader thread, never in an ISR, so it may block
 * briefly. */
typedef void (*sn_frame_handler_t)(uint8_t type, const uint8_t *payload,
				   size_t len);
void sn_link_set_frame_handler(sn_frame_handler_t handler);

/* Counters for the STATS frame. Kept here because this is the only place that
 * knows what actually reached the wire. */
void sn_link_reset_counters(void);
uint32_t sn_link_frames_sent(void);
uint32_t sn_link_bytes_sent(void);

/* Frames refused because the outbound ring was full. Real loss, reported to
 * the host rather than hidden: a sniffer that quietly discards is worse than
 * one that says how much it discarded. */
uint32_t sn_link_frames_dropped(void);

/* The outbound ring's occupancy, for the LINK frame. Occupancy ONLY: frames
 * refused because it was full are counted above and already reach the host in
 * STATS, and carrying them here too would double them in the pcapng
 * interface-statistics blocks.
 *
 * Worth having because drops answer "did I lose anything?" only after the
 * fact, while queue depth answers "am I about to?" -- a ring climbing towards
 * capacity is the warning that precedes the first drop. */
uint32_t sn_link_queued(void);
uint32_t sn_link_high_water(void);
uint32_t sn_link_capacity(void);
```

## src/radio154.h
```c
#pragma once

#include <stdint.h>

/* Mirrors sn_154_meta_t in firmware/main/radio154.h, which the host unpacks as
 * "<BBbBQ" in capture.py. Packed because the host reads it as a flat
 * little-endian struct with no padding, and a field that moves here decodes
 * into a confident wrong number there rather than an error. */
struct __attribute__((packed)) sn_154_meta {
	uint8_t  channel;
	uint8_t  lqi;
	int8_t   rssi_dbm;
	uint8_t  flags;
	uint64_t timestamp_us;
};

/* Binds the radio and configures it for sniffing. Must be called before
 * sn_radio154_start(). Returns 0 on success. */
int sn_radio154_init(void);

int sn_radio154_set_channel(uint8_t channel);
int sn_radio154_start(void);
int sn_radio154_stop(void);

uint8_t sn_radio154_channel(void);

/* Measures the energy on one channel and reports the peak in dBm, then puts
 * the radio back exactly as it was: receiving on its own channel if a capture
 * was running, asleep if not.
 *
 * `duration_symbols` is in 16 us symbols, as the wire format and the ESP32-C6
 * carry it. The driver measures in whole milliseconds, so the window is
 * rounded UP -- a peak found over a longer window can only be higher, which
 * errs toward calling a channel busy rather than quiet.
 *
 * Blocks for the window plus a margin. The caller is the link reader thread,
 * which is waiting for exactly this reply. Returns 0, -EINVAL for a channel or
 * window that cannot be measured, or another negative errno if the driver
 * would not measure. */
int sn_radio154_energy_detect(uint8_t channel, uint32_t duration_symbols,
			      int8_t *out_dbm);

/* Counters for the STATS frame. */
uint32_t sn_radio154_captured(void);
uint32_t sn_radio154_dropped(void);
/* Frames the radio discarded for a bad FCS: counted, never captured. */
uint32_t sn_radio154_fcs_failed(void);
void sn_radio154_reset_counters(void);
```
